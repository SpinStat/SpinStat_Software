## CMakeLists.txt
```
# SPDX-License-Identifier: Apache-2.0
# Copyright (c) 2025 Benedikt Zinn

cmake_minimum_required(VERSION 3.20.0)
find_package(Zephyr REQUIRED HINTS $ENV{ZEPHYR_BASE})
project(spinstat)

target_sources(app PRIVATE src/main.c)
```

## west.yml
```
# SPDX-License-Identifier: Apache-2.0
# Copyright (c) 2025 Benedikt Zinn

manifest:
  version:  0.8
  remotes:
    - name: zephyrproject-rtos
      url-base: https://github.com/zephyrproject-rtos
  projects:
    - name: zephyr
      remote: zephyrproject-rtos
      revision: v3.6.0
      import: true
  self:
    path: SpinStat_Software
```

## prj.conf
```kconfig
# SPDX-License-Identifier: Apache-2.0
# Copyright (c) 2025 Benedikt Zinn


# Enable console output
CONFIG_PRINTK=y
CONFIG_SERIAL=y
```

## src/main.c
```c
/*
 * SPDX-License-Identifier: Apache-2.0
 *
 * Copyright (c) 2025 Benedikt Zinn
 */

#include <zephyr/kernel.h>

void main(void)
{
    while (1)
    {
        k_msleep(100U); // Sleep for 100 ms.
    }
}
```
